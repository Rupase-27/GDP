//
//  OVERVIEW:
//  This code is designed to control 3 GM3506 motors using a STM32G491RE Nucleo board. 
//  The motors are controlled using PWM signals generated by the advanced motor control 
//  timers on the STM32. 
//  The code allows for two modes of operation: guidewire and catheter mode, which can be 
//  toggled using a switch. The motors can be enabled or disabled using a start button, 
//  and an emergency stop button is provided for safety. The speed of the motors can be 
//  adjusted using up and down buttons.
//
//  start() 
//  - Enables the motors when the start button is pressed
//  - Inputs: None
//  - Updates: motorsEnabled
//
//  setPhaseVoltages() 
//  - Sets the PWM duty cycles for the three phases of a motor
//  - Inputs: HardwareTimer reference, timer period, channel numbers, electrical angle
//  - Timer period is the number of ticks in one PWM cycle
//  - Hardware timer passed by so any modifications move through to the main loop
//  - Updates: PWM duty cycles for the specified channels
//
//  initialiseMotorTimer() 
//  - Initializes a hardware timer for PWM generation
//  - Inputs: HardwareTimer reference, pin numbers, channel numbers, timer period reference
//  - Updates: timer_period
//
//  triggerEmergencyStop() 
//  - Disables all motors and prints "EMERGENCY STOP"
//  - Inputs: None
//  - Updates: motorsEnabled
//
//  checkStop() 
//  - Checks if the emergency stop button is pressed and triggers emergency stop
//  - Inputs: None
//
//  updateMode() 
//  - Reads the mode toggleswitch and updates the guidewireMode variable
//  - Inputs: None
//  - Updates: guidewireMode
//
//  updateVelocity() 
//  - Updates the current velocity towards the target velocity based on acceleration and time
//  - Inputs: Current velocity, target velocity, time step (dt)
//  - Returns: Updated current velocity
//
//  updateElectricalAngle()
//  - Updates the electrical angle based on current velocity and time step (dt)
//  - Inputs: Current electrical angle, current velocity, time step (dt)
//  - Returns: Updated electrical angle
//
//  readControls()
//  - Reads the state of control buttons and updates target velocities for each motor
//  - Rotation disabled for catheter mode
//  - Inputs: None
//  - Updates: Target velocities
//
//  readSpeedButtons()
//  - Reads the state of speed control buttons and updates CONTROL_SPEED
//  - Includes debounce logic with edge detection and time constraints to prevent multiple 
//    increments/decrements from a single press
//  - Inputs: None
//  - Updates: CONTROL_SPEED
//
////////////////////////////////////////////////////////////////////////////////


#include <Arduino.h>
#include <HardwareTimer.h>

// Pin connections to board
#define PWM1_A PA10
#define PWM1_B PA9
#define PWM1_C PA8
#define DRIVER1_EN PB10

#define PWM2_A PC6_ALT1
#define PWM2_B PC7_ALT1
#define PWM2_C PC9_ALT1
#define DRIVER2_EN PB5

#define PWM3_A PB2
#define PWM3_B PC2_ALT1
#define PWM3_C PC8_ALT2
#define DRIVER3_EN PC5

// Timer channel connections
#define PWM1_A_CHANNEL 3
#define PWM1_B_CHANNEL 2
#define PWM1_C_CHANNEL 1

#define PWM2_A_CHANNEL 1
#define PWM2_B_CHANNEL 2
#define PWM2_C_CHANNEL 4

#define PWM3_A_CHANNEL 1
#define PWM3_B_CHANNEL 2
#define PWM3_C_CHANNEL 3

#define ESTOP PC3
#define MODE_SWITCH PC4
#define START PB1

// Speed control buttons
#define UP_SPEED PB12
#define DOWN_SPEED PB11

// Direction control buttons
#define BTN_FORWARD PC10
#define BTN_BACK PC11
#define BTN_CW PC12
#define BTN_CCW PD2

#define PWM_FREQUENCY 25000

// Advanced Motor control timers on NUCELO-G491RE
HardwareTimer pwmTimer1(TIM1);
HardwareTimer pwmTimer2(TIM8);
HardwareTimer pwmTimer3(TIM20);

const int pole_pairs = 11;

// Initialisation 
float electrical_angle1 = 0.0f;
float electrical_angle2 = 0.0f;
float electrical_angle3 = 0.0f;

float target_velocity1 = 0.0f;
float target_velocity2 = 0.0f;
float target_velocity3 = 0.0f;

float current_velocity1 = 0.0f;
float current_velocity2 = 0.0f;
float current_velocity3 = 0.0f;

float CONTROL_SPEED = 1.0f;
const float MAX_VELOCITY = 5.0f;

// Increase acceleration to prevent overshoot when changing direction, but not too high to avoid jerky motion
const float acceleration = 50.0f;

// May need to adjust during testing
const int DEBOUNCE_TIME = 100;  

float amplitude = 1.0f;
float supply_voltage = 12.0f;

bool guidewireMode = true;
bool motorsEnabled = false;

uint32_t timer_period1;
uint32_t timer_period2;
uint32_t timer_period3;

uint32_t previous_time;
uint32_t previous_print;

void start()
{
    if (!motorsEnabled && digitalRead(START) == LOW)
    {
        digitalWrite(DRIVER1_EN, HIGH);
        digitalWrite(DRIVER2_EN, HIGH);
        digitalWrite(DRIVER3_EN, HIGH);

        motorsEnabled = true;

        Serial.println("Motors enabled");
    }
}


void setPhaseVoltages(
    HardwareTimer &timer,
    uint32_t timer_period,
    uint32_t channelA,
    uint32_t channelB,
    uint32_t channelC,
    float angle
)
{
    // Calculate the modulation index based on the PWM sine amplitude and supply voltage
    float modulation = amplitude / supply_voltage;

    // Normalize the sine wave to a duty cycle between 0 and 1 using 0.5f
    // Calculates sine waves at 120-degree phase shifts
    float dutyA = 0.5f + modulation * sinf(angle);
    float dutyB = 0.5f + modulation * sinf(angle - 2.0f * PI / 3.0f);
    float dutyC = 0.5f + modulation * sinf(angle + 2.0f * PI / 3.0f);

    dutyA = constrain(dutyA, 0.0f, 1.0f);
    dutyB = constrain(dutyB, 0.0f, 1.0f);
    dutyC = constrain(dutyC, 0.0f, 1.0f);

    // Converts normalised duty cycle to CCR timer ticks value
    timer.setCaptureCompare(
        channelA,
        (uint32_t)(dutyA * timer_period),
        TICK_COMPARE_FORMAT
    );

    timer.setCaptureCompare(
        channelB,
        (uint32_t)(dutyB * timer_period),
        TICK_COMPARE_FORMAT
    );

    timer.setCaptureCompare(
        channelC,
        (uint32_t)(dutyC * timer_period),
        TICK_COMPARE_FORMAT
    );
}

void initialiseMotorTimer(
    HardwareTimer &timer,
    uint32_t pinA,
    uint32_t pinB,
    uint32_t pinC,
    uint32_t channelA,
    uint32_t channelB,
    uint32_t channelC,
    uint32_t &timer_period
)
{
    PinName pinNameA = digitalPinToPinName(pinA);
    PinName pinNameB = digitalPinToPinName(pinB);
    PinName pinNameC = digitalPinToPinName(pinC);

    timer.pause();

    // PWM mode 1 compares the counter against CCR threshold
    // - When the counter is less than CCR, the output is high
    // - When the counter is greater than CCR, the output is low
    timer.setMode(
        channelA,
        TIMER_OUTPUT_COMPARE_PWM1,
        pinNameA
    );

    timer.setMode(
        channelB,
        TIMER_OUTPUT_COMPARE_PWM1,
        pinNameB
    );

    timer.setMode(
        channelC,
        TIMER_OUTPUT_COMPARE_PWM1,
        pinNameC
    );

    // Set to reset the counter at the end of each PWM cycle 
    // PWM freq defined earlier as 25kHz
    timer.setOverflow(
        PWM_FREQUENCY,
        HERTZ_FORMAT
    );

    timer_period = timer.getOverflow(TICK_FORMAT);

    // Sine wave centred around 0.5f, so set initial duty cycle to 50% of timer period
    timer.setCaptureCompare(
        channelA,
        timer_period / 2,
        TICK_COMPARE_FORMAT
    );

    timer.setCaptureCompare(
        channelB,
        timer_period / 2,
        TICK_COMPARE_FORMAT
    );

    timer.setCaptureCompare(
        channelC,
        timer_period / 2,
        TICK_COMPARE_FORMAT
    );

    timer.refresh();
    timer.resume();
}

void triggerEmergencyStop()
{
    digitalWrite(DRIVER1_EN, LOW);
    digitalWrite(DRIVER2_EN, LOW);
    digitalWrite(DRIVER3_EN, LOW);

    motorsEnabled = false;

    Serial.println("EMERGENCY STOP");

    start();

}

void checkStop()
{
    if (digitalRead(ESTOP) == LOW)
    {
        triggerEmergencyStop();
    }
}

void updateMode()
{
    guidewireMode =
        digitalRead(MODE_SWITCH);
}

float updateVelocity(
    float current_velocity,
    float target_velocity,
    float dt
)
{
    if (current_velocity < target_velocity)
    {
        current_velocity += acceleration * dt;

        if (current_velocity > target_velocity)
        {
            current_velocity = target_velocity;
        }
    }
    else if (current_velocity > target_velocity)
    {
        current_velocity -= acceleration * dt;

        if (current_velocity < target_velocity)
        {
            current_velocity = target_velocity;
        }
    }

    return current_velocity;
}

float updateElectricalAngle(
    float electrical_angle,
    float velocity,
    float dt
)
{
    electrical_angle += velocity * pole_pairs *dt;

    while (electrical_angle >= TWO_PI)
    {
        electrical_angle -= TWO_PI;
    }

    while (electrical_angle < 0.0f)
    {
        electrical_angle += TWO_PI;
    }

    return electrical_angle;
}

void readControls()
{
    target_velocity1 = 0.0f;
    target_velocity2 = 0.0f;
    target_velocity3 = 0.0f;

    if (guidewireMode)
    {
        if (!digitalRead(BTN_FORWARD))
        {
            target_velocity1 = CONTROL_SPEED;
        }

        if (!digitalRead(BTN_BACK))
        {
            target_velocity1 = -CONTROL_SPEED;
        }

        if (!digitalRead(BTN_CW))
        {
            target_velocity2 = CONTROL_SPEED;
        }

        if (!digitalRead(BTN_CCW))
        {
            target_velocity2 = -CONTROL_SPEED;
        }
    }
    else
    {
        if (!digitalRead(BTN_FORWARD))
        {
            target_velocity3 = CONTROL_SPEED;
        }

        if (!digitalRead(BTN_BACK))
        {
            target_velocity3 = -CONTROL_SPEED;
        }
    }

    target_velocity1 =
        constrain(
            target_velocity1,
            -MAX_VELOCITY,
            MAX_VELOCITY
        );

    target_velocity2 =
        constrain(
            target_velocity2,
            -MAX_VELOCITY,
            MAX_VELOCITY
        );

    target_velocity3 =
        constrain(
            target_velocity3,
            -MAX_VELOCITY,
            MAX_VELOCITY
        );
}

void readSpeedButtons()
{
    const float SPEED_INCREMENT = 0.2f;

    // Static so doesn't reset every loop iteration, allowing for debounce timing
    static unsigned long lastUpPress = 0;
    static unsigned long lastDownPress = 0;

    static bool previousUpState = HIGH;
    static bool previousDownState = HIGH;

    bool upState = digitalRead(UP_SPEED);
    bool downState = digitalRead(DOWN_SPEED);

    if (upState == LOW && previousUpState == HIGH)
    {
        if (millis() - lastUpPress >= DEBOUNCE_TIME)
        {
            CONTROL_SPEED += SPEED_INCREMENT;

            if (CONTROL_SPEED > MAX_VELOCITY)
            {
                CONTROL_SPEED = MAX_VELOCITY;
            }

            lastUpPress = millis();
        }
    }

    if (downState == LOW && previousDownState == HIGH)
    {
        if (millis() - lastDownPress >= DEBOUNCE_TIME)
        {
            CONTROL_SPEED -= SPEED_INCREMENT;

            if (CONTROL_SPEED < 0.0f)
            {
                CONTROL_SPEED = 0.0f;
            }

            lastUpPress = millis();
        }
    }

    previousUpState = upState;
    previousDownState = downState;
}

void setup()
{
    Serial.begin(115200);
    delay(1000);

    pinMode(DRIVER1_EN, OUTPUT);
    pinMode(DRIVER2_EN, OUTPUT);
    pinMode(DRIVER3_EN, OUTPUT);

    digitalWrite(DRIVER1_EN, LOW);
    digitalWrite(DRIVER2_EN, LOW);
    digitalWrite(DRIVER3_EN, LOW);

    pinMode(ESTOP, INPUT_PULLUP);
    pinMode(MODE_SWITCH, INPUT_PULLUP);
    pinMode(BTN_FORWARD, INPUT_PULLUP);
    pinMode(BTN_BACK, INPUT_PULLUP);
    pinMode(BTN_CW, INPUT_PULLUP);
    pinMode(BTN_CCW, INPUT_PULLUP);
    pinMode(START, INPUT_PULLUP);
    pinMode(UP_SPEED, INPUT_PULLUP);
    pinMode(DOWN_SPEED, INPUT_PULLUP);

    initialiseMotorTimer(
        pwmTimer1,
        PWM1_A,
        PWM1_B,
        PWM1_C,
        PWM1_A_CHANNEL,
        PWM1_B_CHANNEL,
        PWM1_C_CHANNEL,
        timer_period1
    );

    initialiseMotorTimer(
        pwmTimer2,
        PWM2_A,
        PWM2_B,
        PWM2_C,
        PWM2_A_CHANNEL,
        PWM2_B_CHANNEL,
        PWM2_C_CHANNEL,
        timer_period2
    );

    initialiseMotorTimer(
        pwmTimer3,
        PWM3_A,
        PWM3_B,
        PWM3_C,
        PWM3_A_CHANNEL,
        PWM3_B_CHANNEL,
        PWM3_C_CHANNEL,
        timer_period3
    );

    setPhaseVoltages(
        pwmTimer1,
        timer_period1,
        PWM1_A_CHANNEL,
        PWM1_B_CHANNEL,
        PWM1_C_CHANNEL,
        electrical_angle1
    );

    setPhaseVoltages(
        pwmTimer2,
        timer_period2,
        PWM2_A_CHANNEL,
        PWM2_B_CHANNEL,
        PWM2_C_CHANNEL,
        electrical_angle2
    );

    setPhaseVoltages(
        pwmTimer3,
        timer_period3,
        PWM3_A_CHANNEL,
        PWM3_B_CHANNEL,
        PWM3_C_CHANNEL,
        electrical_angle3
    );

    delay(100);

    previous_time = micros();

}

void loop()
{
    start();
    readSpeedButtons();

    static uint32_t lastPrint = 0;

    checkStop();
    updateMode();
    readControls();

    uint32_t current_time = micros();

    float dt =
        (current_time - previous_time) * 1e-6f;

    previous_time = current_time;

    if (dt > 0.01f)
    {
        dt = 0.01f;
    }

    current_velocity1 =
        updateVelocity(
            current_velocity1,
            target_velocity1,
            dt
        );

    current_velocity2 =
        updateVelocity(
            current_velocity2,
            target_velocity2,
            dt
        );

    current_velocity3 =
        updateVelocity(
            current_velocity3,
            target_velocity3,
            dt
        );

    electrical_angle1 =
        updateElectricalAngle(
            electrical_angle1,
            current_velocity1,
            dt
        );

    electrical_angle2 =
        updateElectricalAngle(
            electrical_angle2,
            current_velocity2,
            dt
        );

    electrical_angle3 =
        updateElectricalAngle(
            electrical_angle3,
            current_velocity3,
            dt
        );

    setPhaseVoltages(
        pwmTimer1,
        timer_period1,
        PWM1_A_CHANNEL,
        PWM1_B_CHANNEL,
        PWM1_C_CHANNEL,
        electrical_angle1
    );

    setPhaseVoltages(
        pwmTimer2,
        timer_period2,
        PWM2_A_CHANNEL,
        PWM2_B_CHANNEL,
        PWM2_C_CHANNEL,
        electrical_angle2
    );

    setPhaseVoltages(
        pwmTimer3,
        timer_period3,
        PWM3_A_CHANNEL,
        PWM3_B_CHANNEL,
        PWM3_C_CHANNEL,
        electrical_angle3
    );

    // Testing

    if (millis() - previous_print > 10000)
    {
        previous_print = millis();

        if (guidewireMode)
        {
            Serial.println("MODE: GUIDEWIRE");
        }
        else
        {
            Serial.println("MODE: CATHETER");
        }
    }
}